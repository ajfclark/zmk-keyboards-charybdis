#include "charybdis.dtsi"
#include "charybdis_3610.dtsi"
#include <dt-bindings/zmk/input_transform.h>

&default_transform {
	col-offset = <6>;
};

&spi0 {
    status = "okay";
};

&trackball {
    status = "okay";
};

&trackball_split {
	device = <&trackball>;
};
